         /////////////////////////////////////////////  
        //  Jigglypuff IoT Carbon Dioxide and Dust //
       //      Monitor (Tracker) w/ Telegram      //
      //             ---------------             //
     //      (Arduino Nano RP2040 Connect)      //           
    //             by Kutluhan Aktar           // 
   //                                         //
  /////////////////////////////////////////////

//
// Based on Arduino Nano RP2040 Connect, display the dust density (mg/m3) and the carbon dioxide (CO2) density (ppm) via a Telegram bot.
//
// For more information:
// https://www.theamplituhedron.com/projects/Jigglypuff_IoT_Carbon_Dioxide_and_Dust_Monitor_Tracker_w_Telegram/
//
//
// Connections
// Arduino Nano RP2040 Connect :  
//                                MH-Z14A NDIR CO2 Sensor
// D2  --------------------------- PWM
// RX  --------------------------- TX (Optional) 
// TX  --------------------------- RX (Optional)
//                                GP2Y1010AU0F Dust Sensor
// D4  --------------------------- LED
// A0  --------------------------- S
//                                SSD1306 OLED 128x32
// A4  --------------------------- SDA
// A5  --------------------------- SCL
//                                5mm Common Anode RGB LED
// D3  --------------------------- R
// D5  --------------------------- G
// D6  --------------------------- B   


// Include the required libraries.
#include <SPI.h>
#include <WiFiNINA.h>
#include <Adafruit_GFX.h>
#include <Adafruit_SSD1306.h>

char ssid[] = "<____>";    // your network SSID (name)
char pass[] = "<____>";    // your network password (use for WPA, or use as key for WEP)
int keyIndex = 0;          // your network key Index number (needed only for WEP)
int status = WL_IDLE_STATUS;

// Change the server below before running the code.
char server[] = "www.theamplituhedron.com";

// Define the web application path.
String application = "/telegram_co2_and_dust_monitor/";

// Initialize the Ethernet client library.
WiFiSSLClient client; /* WiFiClient client; */

// Define the SSD1306 screen settings:
#define SCREEN_WIDTH 128 // OLED display width, in pixels
#define SCREEN_HEIGHT 32 // OLED display height, in pixels
#define OLED_RESET    -1 // Reset pin # (or -1 if sharing Arduino reset pin)

Adafruit_SSD1306 display(SCREEN_WIDTH, SCREEN_HEIGHT, &Wire, OLED_RESET);

// Define the MH-Z14A NDIR CO2 Sensor settings:
#define MH_Z14A_PWM 2

// Define the timer for the MH-Z14A NDIR CO2 Sensor:
unsigned long heat_timer = 0;
unsigned long timer = 0;

// Define the data holders:
int co2_level = 0;

// Define the GP2Y1010AU0F Dust Sensor pins (measure and LED) and settings.
int measurePin = A0;
int ledPower = 4;
float voMeasured = 0;
float calcVoltage = 0;
float dustDensity = 0;
float calibration = 0.05;

// Define RGB pins:
#define redPin 3
#define greenPin 5
#define bluePin 6

void setup() {
  // RGB:
  pinMode(redPin, OUTPUT);
  pinMode(greenPin, OUTPUT);
  pinMode(bluePin, OUTPUT);
  adjustColor(0,0,0);

  pinMode(ledPower,OUTPUT);
  pinMode(MH_Z14A_PWM, INPUT_PULLUP);

  // Start the timer:
  heat_timer = millis();

  // Initialize the SSD1306 screen:
  display.begin(SSD1306_SWITCHCAPVCC, 0x3C);
  display.clearDisplay();                                
  display.setTextSize(2);
  display.setCursor(0,0);                              
  display.setTextColor(SSD1306_WHITE);      
  display.println("Heating &");
  display.print("Connecting");
  display.display();
  delay(1000);

  // Check for the WiFi module:
  if (WiFi.status() == WL_NO_MODULE) { adjustColor(255,0,0); while (true); }
  // Attempt to connect to the WiFi network:
  while (status != WL_CONNECTED) {
    // Connect to WPA/WPA2 network. Change this line if using open or WEP network:
    status = WiFi.begin(ssid, pass);
    // Wait 10 seconds for connection:
    delay(10000);
  }
  // If connected to the network successfully:
  adjustColor(0,0,255);
  
}

void loop() {
  // Wait until the MH-Z14A NDIR CO2 Sensor heats for 5 minutes.
  while (millis() - heat_timer < 300000){ if (millis() - timer > 1000){ timer = millis(); } }
  // Get readings from the CO2 Sensor every 20 seconds.
  adjustColor(255,0,255);
  if (millis() - timer > 20000){ MH_Z14A_readings(); timer = millis(); make_a_get_request(); }
  
  // Elicit the dust density generated by the GP2Y1010AU0F dust sensor.
  GP2Y10_dust_sensor_readings();

  display.clearDisplay();                                
  display.setTextSize(1);
  display.setCursor(0,0);                              
  display.setTextColor(SSD1306_WHITE);      
  display.print("Dust: ");
  display.print(dustDensity);
  display.print(" mg/m3");
  display.print("\nCO2: ");
  display.print(co2_level);
  display.print(" ppm");
  display.display();

}

void GP2Y10_dust_sensor_readings(){
  // Calculate the voltage.
  digitalWrite(ledPower,LOW);
  delayMicroseconds(280);
  voMeasured = analogRead(measurePin);
  delayMicroseconds(40);
  digitalWrite(ledPower,HIGH);
  delayMicroseconds(9680);
  // Evaluate the dust density (mg/m3).
  calcVoltage = voMeasured*(3.3/1024);
  dustDensity = 0.17*calcVoltage-0.1;
  // Calibrate data:
  if(dustDensity < 0){ dustDensity = dustDensity + calibration; }
  delay(1000);
}

void MH_Z14A_readings(){
  // Elicit the CO2 density generated by the CO2 Dust Sensor (PWM):
  while (digitalRead(MH_Z14A_PWM) == LOW) {};
  long t0 = millis();
  while (digitalRead(MH_Z14A_PWM) == HIGH) {};
  long t1 = millis();
  while (digitalRead(MH_Z14A_PWM) == LOW) {};
  long t2 = millis();
  long tH = t1-t0;
  long tL = t2-t1;
  long ppm = 5000L * (tH - 2) / (tH + tL - 4);
  while (digitalRead(MH_Z14A_PWM) == HIGH) {};
  co2_level = (int)ppm;
  delay(10);
}

void make_a_get_request(){
  // Connect to the web application named telegram_co2_and_dust_monitor. Change '443' with '80' if you are not using SSL connection.
  if (client.connect(server, 443)){
    // If successful:
    adjustColor(255,255,0);
    // Create the query string:
    String query = application + "?co2="+co2_level+"&dust="+dustDensity;
    // Make an HTTP Get request:
    client.println("GET " + query + " HTTP/1.1");
    client.println("Host: www.theamplituhedron.com");
    client.println("Connection: close");
    client.println();
  }else{
    adjustColor(255,0,0);
  }
  delay(2000); // Wait 2 seconds after connection...
  // If there are incoming bytes available, get the response from the web application.
  String response = "";
  while (client.available()) { char c = client.read(); response += c; }
  if(response != "" && response.indexOf("Data Registered Successfully!") > 0){
    adjustColor(0,255,0);
    display.clearDisplay();                                
    display.setTextSize(1);
    display.setCursor(0,0);                              
    display.setTextColor(SSD1306_WHITE);      
    display.println("Data Registered");
    display.println("Successfully!");
    display.display();
  }
}

void adjustColor(int r, int g, int b){
  analogWrite(redPin, (255-r));
  analogWrite(greenPin, (255-g));
  analogWrite(bluePin, (255-b));
}
